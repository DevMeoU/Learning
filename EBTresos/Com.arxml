AUTOSAR XML (schema 4-0-3)
package /Com
  com config ComConfig
    com signal Signal_1: length=8, init-value=0
    com signal Signal_2: length=16, init-value=255
