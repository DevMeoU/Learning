AUTOSAR XML (schema 4-0-3)
package /Can
  can config CanConfigSet
    can controller CanController_1: baudrate=500000, prop-seg=8, phase-seg1=7, phase-seg2=6, sjw=4
