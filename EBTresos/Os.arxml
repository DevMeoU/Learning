AUTOSAR XML (schema 4-0-3)
package /Os
  os config OsConfig
    os application App1: task=Task1
    task Task1: priority=1, activation=1, schedule=FULL
