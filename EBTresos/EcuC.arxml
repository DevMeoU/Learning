AUTOSAR XML (schema 4-0-3)
package /EcuC
  ecuc configuration EcuCConfig
    ecuc module configuration Os
      ecuc param conf container OsCore
        ecuc numerical param value OsCoreStackSize: value=2048
    ecuc module configuration Memory
      ecuc param conf container MemoryConfig
        ecuc numerical param value RamSize: value=8192
        ecuc numerical param value FlashSize: value=65536
